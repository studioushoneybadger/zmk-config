#include "dactyl_manuform_5x6.dtsi" // Notice that the main dtsi files are included in the overlay.

&kscan0 {
    col-gpios
         = <&pro_micro 9 GPIO_ACTIVE_HIGH> // col6 in the schematic, pin 106
        , <&pro_micro 8 GPIO_ACTIVE_HIGH> // col5 in the schematic, pin 104
        , <&pro_micro 7 GPIO_ACTIVE_HIGH> // col4 in the schematic, pin 011
        , <&pro_micro 6 GPIO_ACTIVE_HIGH> // col3 in the schematic, pin 100
        , <&pro_micro 5 GPIO_ACTIVE_HIGH> // col2 in the schematic, pin 024
        , <&pro_micro 4 GPIO_ACTIVE_HIGH> // col1 in the schematic, pin 022       
        ;

        row-gpios
            = <&pro_micro 18 (GPIO_ACTIVE_HIGH | GPIO_PULL_DOWN)>
            , <&pro_micro 19 (GPIO_ACTIVE_HIGH | GPIO_PULL_DOWN)>
            , <&pro_micro 20 (GPIO_ACTIVE_HIGH | GPIO_PULL_DOWN)>
            , <&pro_micro 21 (GPIO_ACTIVE_HIGH | GPIO_PULL_DOWN)>
            , <&pro_micro 15 (GPIO_ACTIVE_HIGH | GPIO_PULL_DOWN)>
            ;
};

>;
};

   
