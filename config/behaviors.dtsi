/ {
    behaviors {
        hml: home_row_mods_left {
            compatible = "zmk,behavior-hold-tap";
            #binding-cells = <2>;
            flavor = "balanced";
            tapping-term-ms = <280>;
            quick-tap-ms = <175>;
            require-prior-idle-ms = <150>;
            bindings = <&kp>, <&kp>;
            hold-trigger-key-positions = <RIGHT_HAND_KEY_POSITIONS THUMB_KEY_POSITIONS>;  // Replace with actual positions
            hold-trigger-on-release;
        };

        hmr: home_row_mods_right {
            compatible = "zmk,behavior-hold-tap";
            #binding-cells = <2>;
            flavor = "balanced";
            tapping-term-ms = <280>;
            quick-tap-ms = <175>;
            require-prior-idle-ms = <150>;
            bindings = <&kp>, <&kp>;
            hold-trigger-key-positions = <LEFT_HAND_KEY_POSITIONS THUMB_KEY_POSITIONS>;  // Replace with actual positions
            hold-trigger-on-release;
        };
    };
};
