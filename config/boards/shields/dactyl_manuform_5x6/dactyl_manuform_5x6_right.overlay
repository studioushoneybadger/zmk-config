#include "dactyl_manuform_5x6.dtsi"

&default_transform { 
    col-offset = <6>;
};

/ {
    kscan0: kscan {
        compatible = "zmk,kscan-gpio-matrix";
        label = "KSCAN";
        diode-direction = "col2row";

        col-gpios
            = <&pro_micro 4 GPIO_ACTIVE_HIGH> // col1 in the schematic, pin 022
            , <&pro_micro 5 GPIO_ACTIVE_HIGH> // col2 in the schematic, pin 024
            , <&pro_micro 6 GPIO_ACTIVE_HIGH> // col3 in the schematic, pin 100
            , <&pro_micro 7 GPIO_ACTIVE_HIGH> // col4 in the schematic, pin 011
            , <&pro_micro 3 GPIO_ACTIVE_HIGH> // col5 in the schematic, pin 104
            , <&pro_micro 2 GPIO_ACTIVE_HIGH> // col6 in the schematic, pin 106
            ;

         row-gpios
            = <&pro_micro 14 (GPIO_ACTIVE_HIGH | GPIO_PULL_DOWN)>
            , <&pro_micro 19 (GPIO_ACTIVE_HIGH | GPIO_PULL_DOWN)>
            , <&pro_micro 20 (GPIO_ACTIVE_HIGH | GPIO_PULL_DOWN)>
            , <&pro_micro 21 (GPIO_ACTIVE_HIGH | GPIO_PULL_DOWN)>
            , <&pro_micro 10 (GPIO_ACTIVE_HIGH | GPIO_PULL_DOWN)>
            ;
        };

};
